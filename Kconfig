## Kconfig
```kconfig
# Build-time options for RvKernel Manager.
#
# Every entry below declares one option together with its default.
# Values are chosen in .config; options absent from .config fall back
# to their declared default here.

mainmenu "RvKernel Manager"

choice
	prompt "C compiler"
	default CC_GCC

config CC_GCC
	bool "Build with GCC"
	help
	  Compile the whole tree with gcc.

config CC_CLANG
	bool "Build with Clang"
	help
	  Compile the whole tree with clang instead of gcc.

endchoice

config LTO
	bool "Link-Time Optimization (LTO)"
	depends on CC_CLANG
	default n
	help
	  Enable Link-Time Optimization (LTO) when building with Clang to
	  optimize across translation units and produce smaller, faster
	  binaries. Only available when building with Clang.

choice
	prompt "LTO mode"
	default LTO_THIN
	depends on LTO

config LTO_FULL
	bool "Full LTO"
	help
	  Perform full link-time optimization. Produces the most optimal code
	  but requires more memory and link time.

config LTO_THIN
	bool "ThinLTO"
	help
	  Perform Thin link-time optimization. Scalable and faster link times
	  with almost identical optimization results as full LTO.

endchoice

config DEBUG
	bool "Diagnostic logging"
	default y
	help
	  Emit timestamped application messages on stderr: startup and
	  privilege handling, sysfs and procfs access, page construction,
	  refresh ticks, and every setting that gets applied.
	  Disable for a silent build with zero logging overhead.

config CCACHE
	bool "Use ccache"
	default y
	help
	  Prefix compiler invocations with ccache to speed up recompilations.
```
